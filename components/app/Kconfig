## components/app/Kconfig
```kconfig
menu "ePager app"

    config EPAGER_FEATURE_CLOCK_FACES
        bool "Install and choose clock faces (M8b)"
        default y
        help
            PLAN D113: the board advertises the clock_face asset type, checks a face file at the end of its upload,
            keeps the faces and their option values on the assets partition, and the settings list has the Clock face
            pages. Off: the board keeps Classic and the built-in faces cannot be chosen from the settings (the face
            renderer itself stays in the image).

    config EPAGER_DEBUG_CONSOLE
        bool "Debug console on the USB serial port (DEBUG ONLY)"
        default n
        help
            PLAN D57: commands to post and remove sample notifications, set the time and toggle pairing
            mode over the USB console, so the UI can be checked on the board before BLE (M5). Typed text
            becomes notification content on the screen. Never enable it in a release build.

    config EPAGER_BOOT_SOUND
        bool "Play a short chime at boot (boards with a speaker)"
        default n
        help
            PLAN D89: after the first screen has been started, the board plays a three-note chime
            (board_util.h) through its speaker: Paper only so far (ES8311 + NS4150B). Costs about 0.7 s
            of the main task once per boot, no standing current: the codec and amplifier are powered off again.

    config EPAGER_BOOT_SOUND_DAC_VOLUME
        hex "ES8311 DAC volume register for the chime (0x00..0xFF)"
        depends on EPAGER_BOOT_SOUND
        range 0x00 0xFF
        default 0xA0
        help
            Register 0x32, 0.5 dB per step from -95.5 dB at 0x00 (ES8311 datasheet; TODO(hw-verify) the
            reference point, hw-checklist 71). 0xA0 is a quiet start: raise it if the chime is too soft.

    config EPAGER_SOUND_TEST
        bool "Speaker test after the chime (DEBUG ONLY)"
        depends on EPAGER_BOOT_SOUND
        default n
        help
            PLAN D89: 7 s of steady tones (200 Hz to 3.2 kHz), a sweep and a scale, once at boot after the
            chime, to hear what the speaker reproduces. Blocks the main loop meanwhile. Never in a release build.

    config EPAGER_SOUND_TEST_VOICE
        bool "Speech sample after the chime (DEBUG ONLY)"
        depends on EPAGER_BOOT_SOUND
        default n
        help
            PLAN D89: 3.9 s of synthesized speech (components/app/assets/voice_test.pcm, made by
            tools/assets/voice_test.sh with ffmpeg's flite voice; 123 KB in flash), once at boot after the
            chime: does the speaker reproduce a voice. Blocks the main loop meanwhile. Never in a release build.

    config EPAGER_EVENT_LOG
        bool "Event ring in RTC memory (hardware checks)"
        default n
        help
            PLAN D86: the last 96 events (boot and its reset reason, light sleep allowed or off, phone
            connected, secure, disconnected with the reason) with their times, kept in RTC memory. It
            survives a reset but not a power loss; the boot log prints it, so a test on battery can be read
            at the next USB connection. No notification content.

    config EPAGER_BATTERY_LOG
        bool "Battery log on the assets partition (hardware checks)"
        default n
        help
            hw-checklist 27: one line per period with the board's raw battery reading, smoothed value,
            level and charge status in /assets/diag/batlog.csv, with the phone link, the Wi-Fi state, the
            Wi-Fi join attempts, the light-sleep wake-ups and the lost phone links (the counts since boot),
            printed at boot while a USB host is attached (and by the debug console's `batlog`). Lets the
            level and what drained it be checked on battery alone, where there is no USB log. Needs a board
            with battery_diag. No notification content.

    config EPAGER_BATTERY_LOG_PERIOD_S
        int "Seconds between battery log lines"
        depends on EPAGER_BATTERY_LOG
        range 10 3600
        default 60
        help
            The core reads the battery once a minute; a shorter period repeats the last reading.

    config EPAGER_BATTERY_LOG_MAX_KB
        int "Battery log size before it rotates (KiB)"
        depends on EPAGER_BATTERY_LOG
        range 4 512
        default 64
        help
            About 50 bytes a line: 64 KiB holds about 21 hours at one line a minute (4 days at one every
            5 minutes); the previous file (batlog.old) is kept too and printed first.

endmenu
```

## components/ble_core/Kconfig
```kconfig
menu "ePager BLE"

    config EPAGER_BLE_STATS
        bool "Log connection parameters, MTU and PHY (hardware checks)"
        default n
        help
            hw-checklist 1 (throughput): one line when the MTU, the connection parameters or the PHY
            change, and the bytes received and sent per second while a transfer runs. Counts only: no
            notification content, no peer address.

    config EPAGER_BLE_2M_PHY
        bool "Ask for the 2M PHY after connecting"
        default n
        help
            Twice the radio speed when the phone supports it; the throughput check (hw-checklist 1)
            compares it with 1M before it becomes the default.

endmenu
```

## components/core/Kconfig
```kconfig
menu "ePager"

    comment "Variant features: off by default, a variant enables the ones it ships (PLAN section 3)"

    config EPAGER_FEATURE_ANIMATION
        bool "Animation engine"
        default n

    config EPAGER_FEATURE_TOUCH
        bool "Touch input"
        default n

    config EPAGER_FEATURE_OTA
        bool "Firmware updates over BLE"
        default n
        help
            Writes a firmware image sent by the phone into the inactive OTA slot (components/ota), keeps it only
            after a self-check and rolls back otherwise. Needs two OTA slots in the partition table and
            CONFIG_BOOTLOADER_APP_ROLLBACK_ENABLE.

    config EPAGER_LOG_CONTENT
        bool "Log notification content (DEBUG ONLY)"
        default n
        help
            Privacy rule: notification titles, bodies and app names never appear in logs unless this
            is on. Never enable it in a release build.

endmenu
```

## components/net/Kconfig
```kconfig
menu "ePager Wi-Fi and weather"

    config EPAGER_FEATURE_WIFI
        bool "Wi-Fi station for the weather, SNTP and the setup hotspot (PLAN D60, D61)"
        default n
        help
            The radio is on only while fetching (and while the setup hotspot is open). No protocol
            traffic goes over Wi-Fi.

    config EPAGER_FEATURE_WEATHER
        bool "Weather on the idle screen (PLAN D62-D64)"
        depends on EPAGER_FEATURE_WIFI
        default y

    config EPAGER_FEATURE_WIFI_OTA
        bool "Firmware updates from GitHub Releases over Wi-Fi (docs/wifi-ota-plan.md)"
        depends on EPAGER_FEATURE_WIFI && EPAGER_FEATURE_OTA
        default n
        help
            Checks the release manifest once a day (config key update.auto_check) and offers the update on the
            board; installs only when the person chooses. The image is verified like one sent over BLE.

    config EPAGER_UPDATE_URL
        string "Release manifest URL"
        depends on EPAGER_FEATURE_WIFI_OTA
        default "https://github.com/tdpi95/epager-firmware/releases/latest/download/manifest.json"
        help
            Must be https on github.com. The "latest" URL follows the newest release that is not a pre-release;
            a forked repository changes this and its own signing key.

    config EPAGER_WIFI_SETUP_TIMEOUT_S
        int "Close the setup hotspot after this many seconds without a page request"
        depends on EPAGER_FEATURE_WIFI
        range 60 1800
        default 300

endmenu
```

## components/ui_common/Kconfig
```kconfig
menu "ePager UI"

    comment "Layouts compiled into the firmware (PLAN D51); a variant enables the one its display needs"

    config EPAGER_UI_MONO
        bool "1-bit e-paper layout and frame backend (Paper)"
        default y

    config EPAGER_UI_COLOUR
        bool "RGB565 LCD layout, area backend, touch and backlight (LCD)"
        default n

endmenu
```

## variants/lcd/main/Kconfig.projbuild
```kconfig
menu "LCD"

    config EPAGER_LCD_BRINGUP
        bool "P1a bring-up image instead of the product"
        default n
        help
            Test patterns, touch canvas and targets, keys and battery on the console (docs/MILESTONES.md
            P1a), for re-running the hardware checklist items 21-28.

endmenu
```
